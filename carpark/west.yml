## carpark/west.yml
```yaml
manifest:
  remotes:
    - name: zephyrproject-rtos
      url-base: https://github.com/zephyrproject-rtos
    - name: signal-slot
      url-base: https://github.com/signal-slot
  projects:
    - name: zephyr
      remote: zephyrproject-rtos
      revision: v4.4.1
      import:
        name-allowlist:      # ビルドに要る module だけ (全 import の約 10GB を避ける)
          - cmsis
          - hal_espressif    # Core2 (ESP32)
          - hal_xtensa
          - hal_st           # ToF センサ VL53L0X が使う
          - picolibc
    - name: slint            # Core2 対応を入れた fork
      remote: signal-slot
      revision: zephyr-carpark
      path: slint
  self:
    path: carpark
```

## carpark/zephyr/boards/m5stack_core2_esp32_procpu.conf
```kconfig
# 本体の振動モータ (AXP192 の LDO3).
CONFIG_REGULATOR=y
# サーボ (Port B).
CONFIG_PWM=y
# ToF (Port C).
CONFIG_I2C=y
CONFIG_SENSOR=y
# RGB LED (Port A). SPI で波形を作る.
CONFIG_LED_STRIP=y
CONFIG_SPI=y
CONFIG_WS2812_STRIP_SPI=y
# QR コード・リーダ (Port E).
CONFIG_SERIAL=y

# 配線の切り分け用. シリアルのシェルから各部品を直接動かせる.
CONFIG_LED_STRIP_SHELL=y
CONFIG_I2C_SHELL=y
# サーボの位置合わせ.
CONFIG_PWM_SHELL=y
# ピンのレベルを読む.
CONFIG_GPIO_SHELL=y
# センサを直接読む.
CONFIG_SENSOR_SHELL=y
```
